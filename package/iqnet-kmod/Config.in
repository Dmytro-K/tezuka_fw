## package/iqnet-kmod/Config.in
```kconfig
config BR2_PACKAGE_IQNET_KMOD
	bool "iqnet kernel module"
	depends on BR2_LINUX_KERNEL
	help
	  Kernel module providing /dev/iqnet: streams IIO DMA blocks
	  (cf-ad9361-lpc RX) as UDP datagrams with zero CPU copies.
	  The IIO block pages are attached to skbs as frags and read
	  directly by the GEM; blocks are returned to the DMA queue
	  when transmission completes.

	  Requires the tezuka kernel patches providing
	  iio_buffer_get_from_file(), iio_buffer_claim_blocks(),
	  iio_buffer_release_blocks() and SKBFL_COHERENT_FRAGS.
	  Controlled by iqnetd.

comment "iqnet kernel module needs a Linux kernel to be built"
	depends on !BR2_LINUX_KERNEL
```

## package/iqnetd/Config.in
```kconfig
config BR2_PACKAGE_IQNETD
	bool "iqnetd"
	depends on BR2_LINUX_KERNEL
	select BR2_PACKAGE_IQNET_KMOD
	help
	  Control daemon for iqnet zero-copy UDP IQ streaming. Listens
	  on TCP port 30433 (START/STOP/STATS, see
	  package/iqnet-kmod/src/iqnet_proto.h), prepares the
	  cf-ad9361-lpc IIO DMA buffer and hands it over to the iqnet
	  kernel module, which sends the DMA blocks to the TCP peer
	  over UDP without copying them.

comment "iqnetd needs a Linux kernel to be built"
	depends on !BR2_LINUX_KERNEL
```
